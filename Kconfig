## Kconfig
```kconfig
#
# For a description of the syntax of this configuration file,
# see the file kconfig-language.txt in the NuttX tools repository.
#

menuconfig SYSTEM_MODBUS_GATEWAY
	bool "Modbus Gateway"
	default n
	---help---
		This selection enables the Modbus-RTU <-> TCP gateway
```
